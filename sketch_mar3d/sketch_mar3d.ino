// https://www.engineersgarage.com/arduino-ssd1306-oled-display/
// https://components101.com/displays/oled-display-ssd1306
// https://quartzcomponents.com/products/0-96-monochrome-oled-display-ssd1306
// https://learn.adafruit.com/adafruit-gfx-graphics-library/graphics-primitives

#include <SPI.h>
#include <Wire.h>
#include <Adafruit_GFX.h>
#include <Adafruit_SSD1306.h>

#define SCREEN_WIDTH 128 // OLED display width, in pixels
#define SCREEN_HEIGHT 64 // OLED display height, in pixels

// Declaration for SSD1306 display connected using software SPI (default case):
#define OLED_MOSI   9 // D1
#define OLED_CLK   10 // D0
#define OLED_DC    11 // DC
#define OLED_CS    12 // CS
#define OLED_RESET 13 // RES
Adafruit_SSD1306 display(SCREEN_WIDTH, SCREEN_HEIGHT,
  OLED_MOSI, OLED_CLK, OLED_DC, OLED_RESET, OLED_CS);

String hours = "--";
String minutes = "--";
String seconds = "--";
String frames = "--";

const unsigned char bitmerhp [] PROGMEM = {
0x00, 0x00, 0x01, 0xe0, 0x07, 0x80, 0x00, 0x00, 0x00, 0x00, 0x01, 0xe0, 0x07, 0x80, 0x00, 0x00, 
	0x00, 0x00, 0x01, 0xe0, 0x07, 0x80, 0x00, 0x00, 0x00, 0x00, 0x01, 0xe0, 0x07, 0x80, 0x00, 0x00, 
	0x00, 0x00, 0x01, 0xe0, 0x07, 0x80, 0x00, 0x00, 0x00, 0x00, 0x01, 0xe0, 0x07, 0x80, 0x00, 0x00, 
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	0x00, 0x1f, 0x80, 0x00, 0x00, 0x01, 0xf8, 0x00
};

const unsigned char dvd [] PROGMEM = {
	0x0f, 0xff, 0xfe, 0x01, 0xff, 0xf8, 0x00, 0x0f, 0xff, 0xfe, 0x01, 0xff, 0xff, 0x00, 0x0f, 0xff, 
	0xfe, 0x03, 0xff, 0xff, 0x80, 0x00, 0x07, 0xff, 0x07, 0xc0, 0x0f, 0xc0, 0x1f, 0x03, 0xef, 0x0f, 
	0xbe, 0x07, 0xc0, 0x1f, 0x03, 0xef, 0x1f, 0x3e, 0x07, 0xc0, 0x1f, 0x03, 0xef, 0x9e, 0x3c, 0x07, 
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	0x80, 0x00
};

void setup() {
  Wire.begin(5);
  Wire.onReceive(receiveEvent);
  Serial.begin(9600);

  display.begin(SSD1306_SWITCHCAPVCC);
  display.display();
}

int counter = 0;
void loop() {
  counter++;
  if (counter % 500 == 0) {
    Serial.println(String(hours+"."+minutes+"."+seconds+"."+frames));
  }

  printtext(); 
}

void printtext(void){
  display.clearDisplay();
  display.setTextColor(SSD1306_WHITE);
  display.setCursor(16, 0);
  display.setTextSize(2); 
  display.println(String(hours+"."+minutes+"."+seconds).c_str());

  display.setCursor(52, 25);
  display.println(String(frames).c_str());

  
  if (frames != "--") {
    float screenWidth = SCREEN_WIDTH;
    float center = screenWidth / 2.0;
    float factor = screenWidth / 25.0;
    float width = screenWidth - frames.toFloat() * factor;

    // float lol = sin(frames.toFloat()) * 10;
    // display.drawBitmap(0, lol, bitmerhp, 64, 59, WHITE);

    dvdJon();

    display.fillRect(center - (width / 2.0), SCREEN_HEIGHT - 3, width, 3, WHITE);
  }
  display.display();
}

String yDir = "up";
String xDir = "right";
float xPos = 50;
float yPos = 50;
float dvdWidth = 50;
float dvdHeight = 30;
float dvdSpeed = 0.75;
void dvdJon() {
  // upper boundary
  if (yPos < 0) {
    yDir = "down";
  }
  // right boundary
  if (xPos + dvdWidth > SCREEN_WIDTH) {
    xDir = "left";
  }
  // bottom boundary
  if (yPos + dvdHeight > SCREEN_HEIGHT) {
    yDir = "up";
  }
  // left boundary
  if (xPos < 0) {
    xDir = "right";
  }

  if (xDir == "right") {
    xPos += dvdSpeed;
  } else {
    xPos -= dvdSpeed;
  }


  if (yDir == "up") {
    yPos -= dvdSpeed;
  } else { 
    yPos += dvdSpeed;
  }

  display.drawBitmap(xPos, yPos, dvd, 50, 30, WHITE);
}

void receiveEvent(int howMany)
{
  String str = "";
  while(Wire.available()) // loop through all but the last
  {
    char c = Wire.read(); // receive byte as a character
    str += c;
  }

  hours = str.substring(0, 2);
  minutes = str.substring(2, 4);
  seconds = str.substring(4, 6);
  frames = str.substring(6, 8);
}